/*
 * One USB CDC: Studio RPC and printk share it.
 * Printk is framed as L-prefixed Studio frames by the zmk-studio-log module
 * (uart_console must not also own this UART).
 */
/ {
    chosen {
        zmk,studio-rpc-uart = &board_cdc_acm_uart;
    };
};

&totem_console_uart {
    status = "disabled";
};
