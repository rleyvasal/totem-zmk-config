## Kconfig
```kconfig
config TOTEM_FAULT_CAPTURE
	bool "Record crashes (reason + faulting PC) across a reset"
	select THREAD_NAME
	default n
	help
	  Override k_sys_fatal_error_handler() to record the K_ERR_* reason, the faulting
	  program counter and the running thread into a __noinit RAM struct, print it, and
	  reboot. The next boot reports it via totem_fault_report_and_clear().
	  This is the other half of the 2026-07-26 freeze investigation: the watchdog
	  recovers the keyboard but cannot say why it stopped. A crash lands here with a
	  PC that addr2line resolves to a source line against the matching zmk.elf; a hang
	  never reaches it, so silence after a watchdog reset is itself the diagnosis.
	  The record is magic+CRC protected because __noinit RAM survives a soft reset but
	  is garbage after a power cut, and a garbage record read as a fault would be
	  worse than no record at all.
	  Module src/totem_fault.c. Keep the zmk.elf for whatever build you flashed, or a
	  captured PC is just a number.

config TOTEM_WATCHDOG
	bool "Hardware watchdog: reset the SoC if the firmware stops running"
	select WATCHDOG
	select TASK_WDT
	select TOTEM_FAULT_CAPTURE
	default n
	help
	  Arm the nRF52840 WDT through Zephyr's task watchdog and feed it from three
	  independent contexts, so a hang reports WHICH one stopped rather than just that
	  the firmware died:
	    sched    - lowest-priority thread (scheduler no longer runs normal threads)
	    sysworkq - self-rescheduling delayed work (system workqueue wedged; the prime
	               suspect, since most ZMK/BLE work runs there)
	    timer    - k_timer expiry in ISR context (survives thread starvation, so
	               "only timer fed" localises the fault to scheduling)
	  The expiring channel is recorded via TOTEM_FAULT_CAPTURE and printed next boot.
	  NOTE the callback runs in ISR context (task_wdt uses a k_timer), so it records
	  to RAM and resets -- it cannot persist to flash.
	  This is the only recovery for the 2026-07-26 failure: the left half sat
	  powered but not executing for five hours -- no USB enumeration, no
	  advertising, no keypress handling -- with a charged battery and a working
	  cable. Every other recovery path in this firmware is software, and software
	  does not run on a stopped core (that includes TOTEM_RECOVERY_REBOOT, which
	  calls sys_reboot). Bonds, profiles and settings live in NVS and survive a
	  watchdog reset; it is equivalent to [ + Z, not a settings reset.
	  NOTE: the nRF WDT cannot be stopped once started, and it keeps counting in
	  SYSTEM ON sleep -- which is exactly what we need, since the hang looks like
	  an idle CPU. Module src/totem_watchdog.c.

config TOTEM_WATCHDOG_TIMEOUT_MS
	int "Watchdog timeout in milliseconds"
	depends on TOTEM_WATCHDOG
	default 10000
	range 2000 60000
	help
	  Time without a feed before the SoC resets. Fed every TIMEOUT/3, so two
	  consecutive missed feeds are tolerated before the dog bites. 10 s is long
	  enough that no normal stall (flash write, BLE storm, settings save) trips it
	  and short enough that a real hang costs you a couple of seconds rather than
	  five hours.

config TOTEM_RESET_REASON_CAPTURE
	bool "Record why the SoC last reset (power-on, watchdog, brownout, ...)"
	select HWINFO
	default y
	help
	  Read hwinfo_get_reset_cause() once at boot, print it via printk, and store a
	  TOTEM_HEVT_BOOT record in the host event ring. Without this a watchdog reset
	  is indistinguishable from someone bumping the reset button, and the 07-26
	  incident showed that "what state was it in before it died" is the question we
	  can never answer after the fact. Cheap: one read plus one ring entry per boot.
	  Independent of TOTEM_WATCHDOG -- useful even with the watchdog off, since it
	  also distinguishes brownouts from clean power-ons.

config TOTEM_BOOT_PROFILE_DUMP
	bool "printk each profile's stored host address at boot"
	depends on ZMK_BLE && ZMK_SPLIT_ROLE_CENTRAL
	default y
	help
	  Print `totem_prof <n> <addr>` for every profile at boot, marking the active one
	  with * and empty slots with EMPTY. This is the single most useful diagnostic we
	  have: 2026-07-25 was an active profile that was never paired, and 2026-07-26 was
	  profile 0 holding 00:00:00:00:00:00 while macOS still had its half of the bond.
	  Both were answered by one line. ZMK already logs this as `Loaded ... address for
	  profile N`, but that is a LOG_DBG and TOTEM_USB_CONSOLE leaves CONFIG_LOG off, so
	  on a production image it does not exist -- answering the question meant reflashing
	  to a debug build and destroying the state being investigated.
	  Printed from delayed work, NOT from SYS_INIT: zmk_ble_init() only registers the
	  settings handler, and settings_load() runs in ZMK's main() after every SYS_INIT
	  level. Dumping at init prints all-zeroes on a keyboard with perfectly good bonds.
	  Central-only: zmk_ble_profile_address() and zmk_ble_active_profile_index() are
	  not linked into a peripheral build, so the right half must not select this.
	  Implemented in src/totem_watchdog.c.

config TOTEM_BOOT_PROFILE_DUMP_DELAY_MS
	int "Delay before printing boot diagnostics (ms)"
	depends on TOTEM_BOOT_PROFILE_DUMP || TOTEM_ENDPOINT_LOG
	default 4000
	range 500 30000
	help
	  Must outlast ZMK's main() reaching settings_load(); a few seconds also lets USB
	  enumerate so the line is not printed into a console nobody has attached yet.

config TOTEM_ENDPOINT_LOG
	bool "printk the HID endpoint whenever it changes"
	depends on ZMK_BLE && ZMK_SPLIT_ROLE_CENTRAL
	default y
	help
	  Print `totem_ep changed selected=... preferred=...` on every endpoint change,
	  plus once at boot. Which transport is carrying keystrokes is otherwise invisible
	  -- typing looks identical over USB and BLE -- and it cannot be tested by
	  elimination, because ZMK falls back: get_selected_transport() silently uses the
	  other transport when the preferred one is not ready. So "forced BLE, turned
	  Bluetooth off, still typing" proves nothing; BLE went not-ready and USB took
	  over. Printing preferred AND selected makes that case explicit via a FALLBACK
	  marker. Needed to verify the &out bindings do anything at all.
	  Module src/totem_endpoint_log.c. Uses TOTEM_BOOT_PROFILE_DUMP_DELAY_MS for its
	  boot report, since the preferred endpoint is restored by settings_load() in
	  main(), after every SYS_INIT level.
	  Central-only: a split peripheral has no HID endpoints, so
	  zmk_endpoint_get_selected()/_preferred() are not linked into that build.

config TOTEM_USB_CONSOLE
	bool "USB CDC console on production builds (printk only, no log subsystem)"
	select USB
	select USB_DEVICE_STACK
	select USB_CDC_ACM
	select SERIAL
	select CONSOLE
	select UART_INTERRUPT_DRIVEN
	select UART_LINE_CTRL
	select UART_CONSOLE
	select USB_UART_CONSOLE
	default n
	help
	  Expose a USB serial console so &host_log_dump ([ + X) can actually print on a
	  normal build. This is NOT the zmk-usb-logging snippet: that enables the full
	  deferred logging subsystem with a log thread and per-message formatting, and
	  is what was disabled in 3046d8f for hanging during profile switches. The dump
	  path uses plain printk and needs only a console, so this gives you readable
	  incident data at a fraction of the cost. Leaves CONFIG_LOG alone.
	  Trade-off: adds a CDC ACM interface to the USB descriptor (the keyboard shows
	  up as a composite device) and costs a little RAM. Set n if USB HID misbehaves.

config TOTEM_EXCLUSIVE_HOST
	bool "Keep only the active profile's computer connected (evict background hosts)"
	depends on ZMK_BLE
	default n
	help
	  Disconnect any non-active host so only the selected computer stays linked.
	  Prevents wake/cross-talk and dual-link battery cost, but every BT_SEL pays
	  a full reconnect (often slow on Windows). Prefer TOTEM_LAZY_INACTIVE_HOST
	  for fast switches with multi-link + lazy params on the inactive host.
	  Module src/exclusive_host.c. Central-only. Do not enable together with
	  TOTEM_LAZY_INACTIVE_HOST (lazy mode wants background hosts to stay up).

config TOTEM_LAZY_INACTIVE_HOST
	bool "Multi-link: keep inactive hosts connected with lazy connection params"
	depends on ZMK_BLE
	depends on !TOTEM_EXCLUSIVE_HOST
	default n
	help
	  Leave non-active bonded hosts connected so profile switch does not force
	  a full BLE reconnect (near-instant BT_SEL after both have linked once).
	  Request long interval / high latency on inactive links to reduce battery
	  use and link activity that can disturb a sleeping PC. Active profile gets
	  normal snappy peripheral preferred params. HID still only to active
	  profile. Module src/lazy_inactive_host.c. Central-only.

config TOTEM_LAZY_HOST_MIN_INT
	int "Lazy inactive host min connection interval (1.25 ms units)"
	depends on TOTEM_LAZY_INACTIVE_HOST
	default 80
	range 24 320
	help
	  80 = 100 ms. Host may negotiate differently.

config TOTEM_LAZY_HOST_MAX_INT
	int "Lazy inactive host max connection interval (1.25 ms units)"
	depends on TOTEM_LAZY_INACTIVE_HOST
	default 160
	range 24 320
	help
	  160 = 200 ms.

config TOTEM_LAZY_HOST_LATENCY
	int "Lazy inactive host slave latency (events)"
	depends on TOTEM_LAZY_INACTIVE_HOST
	default 4
	range 0 30

config TOTEM_LAZY_HOST_TIMEOUT
	int "Lazy inactive host supervision timeout (10 ms units)"
	depends on TOTEM_LAZY_INACTIVE_HOST
	default 500
	range 100 3200
	help
	  500 = 5 s.

config TOTEM_EXCLUSIVE_DISCONNECT_REASON
	hex "HCI reason code used to disconnect a background host"
	depends on TOTEM_EXCLUSIVE_HOST
	default 0x13
	help
	  Passed to bt_conn_disconnect() when evicting a background host. 0x13 =
	  remote user terminated (default). Other reasons Zephyr accepts: 0x15 (remote
	  powered off), 0x1A (unsupported remote feature), 0x05 (authentication
	  failure). Tunable because some hosts (notably macOS) mishandle input after a
	  plain user-terminated disconnect; a different reason may make the host
	  reconnect cleanly.

config TOTEM_EVICT_REQUIRES_BONDED_ACTIVE
	bool "Never evict a bonded host while the active profile is unbonded"
	depends on TOTEM_EXCLUSIVE_HOST
	default y
	help
	  Suppress background-host eviction whenever the active profile has no bond
	  (zmk_ble_active_profile_is_open()). Without this, selecting an empty
	  profile makes the keyboard reject the only computer that wants it, forever:
	  the host connects, eviction fires on idx != active, the host retries, and
	  the loop runs at several hertz until a BT_SEL rescues it. Observed
	  2026-07-25 with active=4 and macOS bonded at idx=0 -- 16 evictions per 10 s
	  window, macOS permanently greyed out, and the split slot table corrupted as
	  collateral. Exclusivity only has a meaning to enforce when the selected
	  profile actually has a host, so this costs nothing when one is paired.
	  Implemented in src/exclusive_host.c. Central-only.

config TOTEM_BOND_HEAL
	bool "Auto-clear active profile bond after repeated auth failures"
	depends on TOTEM_EXCLUSIVE_HOST
	default n
	help
	  When the active host fails encryption/auth repeatedly (HCI 0x05 or
	  security_changed errors), clear that profile's bond on the keyboard.
	  Default n: dual-host thrash can produce transient security errors that
	  must not wipe a good bond. Experimental only with a logging build.
	  Implemented in src/exclusive_host.c. Central-only.

config TOTEM_BOND_HEAL_THRESHOLD
	int "Consecutive active-profile auth failures before bond clear"
	depends on TOTEM_BOND_HEAL
	default 3
	range 2 10

config TOTEM_RESELECT_RECONNECT
	bool "Re-selecting the active profile forces a soft reconnect"
	depends on TOTEM_ADV_THROTTLE
	default y
	help
	  Pressing BT_SEL for the profile that is already active disconnects that
	  host (if connected) and re-advertises with the boost window. Soft recovery
	  for half-dead links (especially macOS Connected-but-mute) without a full
	  Forget + re-pair. Implemented in patches/zmk-ble.patch. Central-only.

config TOTEM_EVICT_ADV_COOLDOWN_MS
	int "Delay re-advertising after a non-active host disconnects (ms)"
	depends on TOTEM_ADV_THROTTLE
	default 0
	range 0 5000
	help
	  When a background (non-active) host disconnects and the active profile is
	  still not connected, wait this many milliseconds before restarting open
	  advertising. DEFAULT 0 (off): a non-zero value also blinds the *selected*
	  host during the pause, which made dual-host switch worse (Win thrash
	  starved Mac). Keep 0 unless experimenting with a logging build. Profile
	  switch and active-host disconnect always re-advertise immediately.
	  Implemented in patches/zmk-ble.patch. Central-only.

config TOTEM_ACTIVE_ADV_FILTER
	bool "Advertise with filter accept list: only active profile may connect"
	depends on TOTEM_ADV_THROTTLE
	depends on BT_FILTER_ACCEPT_LIST
	default n
	help
	  When the active profile is bonded, advertising uses
	  BT_LE_ADV_OPT_FILTER_CONN and the filter accept list contains only that
	  profile's peer. Background bonded hosts cannot complete a connection
	  (stops multi-host thrash that can rot the selected bond). Open/empty
	  profiles advertise unfiltered for pairing. Fail-open: any FAL setup or
	  filtered start failure falls back to unfiltered open advertising.
	  Earlier 2026-07 attempt: no ads on some builds — re-enabled 2026-07-21
	  with clearer fallback; set n in totem.conf if ads vanish. Central-only.

config TOTEM_RECONNECT_WATCH
	bool "Watchdog for stuck profile-switch reconnects"
	depends on ZMK_BLE
	default y
	help
	  After BT_SEL, if the active bonded host does not come up, run a recovery
	  ladder: kick advertising, force-evict background hosts, then soft-drop a
	  zombie host conn. Never clears bonds. Module src/reconnect_watch.c.
	  Central-only.

config TOTEM_RECONNECT_WATCH_SEC
	int "Seconds between reconnect watch recovery steps"
	depends on TOTEM_RECONNECT_WATCH
	default 8
	range 4 30

config TOTEM_RECONNECT_WATCH_ON_ACTIVE_DOWN
	bool "Arm light reconnect ladder when the active host disconnects mid-session"
	depends on TOTEM_RECONNECT_WATCH
	default y
	help
	  When a peer that maps to the active profile disconnects (not background
	  thrash, not unresolved RPA), arm the light recovery ladder: densify ads /
	  kick open advertising, force-evict background hosts, soft-drop zombie.
	  Never full reselect (avoids Class D mute risk). Skips when advertising is
	  intentionally suppressed (idle go-dark / throttle). Central-only.

config TOTEM_THRASH_DETECT
	bool "Count background host evictions for multi-host thrash logging"
	depends on TOTEM_EXCLUSIVE_HOST
	default y
	help
	  Maintain a sliding-window counter of successful exclusive-host background
	  evictions (any non-active profile) and emit totem_ble thrash_win /
	  CLASS_A_SUSPECT logs. Does not change advertising or eviction behavior by
	  itself. Central-only.

config TOTEM_THRASH_WINDOW_SEC
	int "Seconds in the thrash sliding window"
	depends on TOTEM_THRASH_DETECT
	default 10
	range 3 60

config TOTEM_HOST_EVENT_LOG
	bool "Multi-profile host event ring (RAM + settings) with USB dump"
	depends on ZMK_BLE
	default y
	help
	  Record connect/disconnect/security/thrash/watch events for any BLE
	  profile index into a circular ring. Persist snapshots to settings so
	  history survives reboot and firmware flash (without settings-reset).
	  Dump with &host_log_dump (combo) via printk over USB CDC when console
	  logging is enabled (zmk-usb-logging snippet or CONFIG_ZMK_USB_LOGGING).
	  Capture works on the normal production image without USB attached.
	  Implemented in src/host_event_log.c. Central sources; dump on left.

config TOTEM_HOST_EVENT_LOG_SIZE
	int "Host event ring capacity"
	depends on TOTEM_HOST_EVENT_LOG
	default 128
	range 32 256

config TOTEM_HOST_EVENT_LOG_PERSIST_EVERY
	int "Persist ring to settings after this many new events"
	depends on TOTEM_HOST_EVENT_LOG
	default 32
	range 1 128
	help
	  Count threshold before a flash snapshot is *requested*. Actual writes
	  are also rate-limited by TOTEM_HOST_EVENT_LOG_PERSIST_MIN_MS so thrash
	  storms cannot spam NVS (which can hang the central / kill USB+BLE).

config TOTEM_HOST_EVENT_LOG_PERSIST_MIN_MS
	int "Minimum milliseconds between host-event flash persists"
	depends on TOTEM_HOST_EVENT_LOG
	default 60000
	range 5000 600000
	help
	  Coalesce settings writes during dual-host thrash. RAM ring still
	  records every event; only NVS is throttled. Dump still requests a
	  persist (subject to this interval).

config TOTEM_ADV_THROTTLE
	bool "Pause advertising after the selected host has been away for a while"
	depends on ZMK_BLE
	default n
	help
	  When the selected profile's device has been disconnected for
	  TOTEM_ADV_THROTTLE_TIMEOUT_MIN minutes, stop advertising to save power. A key
	  press on either half resumes it (the first press or two may be lost). This also
	  stops cross-talk -- nothing can connect while not advertising -- so it does not
	  need address-based filtering. Implemented by patches/zmk-ble.patch on our ZMK
	  fork. Central-only.

config TOTEM_ADV_THROTTLE_TIMEOUT_MIN
	int "Minutes the selected host may be away before advertising is paused"
	depends on TOTEM_ADV_THROTTLE
	default 5

config TOTEM_ADV_BOOST
	bool "Faster advertising after profile switch (and wake from dark)"
	depends on TOTEM_ADV_THROTTLE
	default y
	help
	  For TOTEM_ADV_BOOST_SEC after a profile switch (or keypress resume from
	  advertising-dark), advertise at Bluetooth GAP "fast interval 1" (30-60 ms)
	  instead of ZMK's default "fast interval 2" (100-150 ms). Denser advertising
	  helps the newly selected host discover the keyboard sooner. Implemented in
	  patches/zmk-ble.patch. Central-only. Small extra radio use only during the
	  short boost window.

config TOTEM_ADV_BOOST_SEC
	int "Seconds of dense advertising after profile switch"
	depends on TOTEM_ADV_BOOST
	default 12
	range 3 60

config TOTEM_ADV_POST_SWITCH_DARK
	bool "After profile-switch boost, go dark if selected host not connected"
	depends on TOTEM_ADV_BOOST
	default y
	help
	  When the boost window after BT_SEL ends and the selected host is still
	  not connected, pause advertising until a keypress. Limits open-ad thrash
	  from background bonded hosts (which can rot the selected bond) without
	  Filter Accept List. Cost: if the host is slow, press any key to resume
	  advertising. Implemented in patches/zmk-ble.patch. Central-only.

config TOTEM_DIR_THEN_OPEN
	bool "Directed advertising then open undirected after profile switch"
	depends on TOTEM_ADV_THROTTLE
	default n
	help
	  After BT_SEL (exclusive-host still drops the previous host), first
	  advertise *directed* to the active bonded peer for TOTEM_DIR_ADV_SEC,
	  then fall back to open undirected (with boost if enabled). Goal: faster
	  discovery for the selected host without multi-link. Directed may fail
	  on some privacy centrals — fail-open to undirected immediately.
	  Implemented in patches/zmk-ble.patch. Central-only.

config TOTEM_DIR_ADV_SEC
	int "Seconds of directed advertising after profile switch"
	depends on TOTEM_DIR_THEN_OPEN
	default 4
	range 1 15
	help
	  Low-duty directed phase length before open undirected. Keep short so
	  macOS (RPA) still gets undirected boost quickly if directed does not
	  help.

config TOTEM_IDLE_DISCONNECT
	bool "Disconnect the active host after a long keypress-idle window (then go dark)"
	depends on TOTEM_ADV_THROTTLE
	default n
	help
	  On the central half: after CONFIG_TOTEM_IDLE_DISCONNECT_MIN minutes with no
	  keypress, disconnect the active host AND immediately pause advertising ("go
	  dark"), so it cannot instantly reconnect and wake the host. A key press resumes
	  advertising (via the throttle listener) and the host reconnects; an asleep/away
	  host simply stays gone, so idle drain falls to the throttled rate with no wake
	  storm. macOS keeps its BLE link alive during sleep, so without this the keyboard
	  stays connected-idle overnight. Requires TOTEM_ADV_THROTTLE (shares its
	  advertising-pause machinery). Implemented in patches/zmk-ble.patch on the ZMK
	  fork, not a standalone module. Central-only.

config TOTEM_IDLE_DISCONNECT_MIN
	int "Minutes without a keypress before the active host is disconnected"
	depends on TOTEM_IDLE_DISCONNECT
	default 20

config TOTEM_RPA_DISCONNECT
	bool "Find RPA-connected hosts when disconnecting a profile"
	depends on ZMK_BLE
	default y
	help
	  zmk_ble_prof_disconnect() looks the host up only by its stored *identity*
	  address, which misses when the host is connected under a resolvable private
	  address (macOS always is) and returns -ENODEV. Meanwhile
	  zmk_ble_profile_is_connected() does resolve RPAs, so a stale conn object can
	  look connected while nothing is able to tear it down: update_advertising()
	  then stays dark on purpose, every recovery path skips, and repeated BT_SEL
	  does nothing -- only a power cycle recovers (observed 2026-07-24, macOS away
	  6 h). With this on, the disconnect falls back to the same IRK-aware conn
	  lookup. Side effect: BT_SEL on the already-active profile now really drops a
	  live macOS link instead of silently failing. Set n to restore the old
	  identity-address-only behaviour. Implemented in patches/zmk-ble.patch.

config TOTEM_ADV_RECONCILE
	bool "Rebuild advertising state from scratch on explicit user intent"
	depends on TOTEM_ADV_THROTTLE
	default y
	help
	  A keypress while the selected host is down, or BT_SEL, means the user wants
	  that host connected now. Instead of trusting advertising_status (which can
	  claim ZMK_ADV_CONN while the controller is not advertising, a state
	  update_advertising() cannot leave because desired == current matches no
	  switch case), force the baseline: cancel throttle/retry work, clear the
	  throttle, stop advertising accepting -EALREADY, reset the status, restart.
	  Rate-limited by TOTEM_ADV_RECONCILE_COOLDOWN_MS so held or repeated keys
	  cannot thrash the radio. Never disconnects a host on a keypress -- only the
	  BT_SEL path may do that. Implemented in patches/zmk-ble.patch. Central-only.

config TOTEM_ADV_RECONCILE_COOLDOWN_MS
	int "Minimum milliseconds between keypress-driven advertising reconciles"
	depends on TOTEM_ADV_RECONCILE
	default 10000
	range 1000 60000
	help
	  A reconcile restarts advertising, so doing it on every keystroke while the
	  host is away would keep resetting the advertising interval and make the
	  keyboard *harder* to discover. 10 s is well inside the couple of seconds a
	  present host needs to connect once ads are actually running.

config TOTEM_ZOMBIE_VERIFY_MS
	int "Milliseconds to confirm a BT_SEL disconnect actually tore the link down"
	depends on TOTEM_ADV_RECONCILE
	default 2000
	range 500 10000
	help
	  After BT_SEL asks the active host to disconnect, re-check whether the
	  profile still reports connected. Still connected after this long means the
	  conn object is wedged -- objective evidence for TOTEM_RECOVERY_REBOOT.

config TOTEM_RECOVERY_REBOOT
	bool "Reboot the central as last resort when BLE recovery cannot proceed"
	depends on TOTEM_ADV_RECONCILE
	select REBOOT
	default y
	help
	  So the keyboard never needs its physical power switches to recover. Fires
	  only on objective evidence, never merely because a host is absent: either
	  bt_le_adv_start() returned genuine errors for the whole open-adv retry
	  budget after the user asked for a reconnect, or the active profile still
	  reported connected TOTEM_ZOMBIE_VERIFY_MS after a BT_SEL disconnect. Cold
	  reboot only -- equivalent to &sys_reset, so bonds, profiles and settings in
	  NVS all survive; this is NOT a settings reset. The peripheral half
	  reconnects on its own. Implemented in patches/zmk-ble.patch. Central-only.

config TOTEM_RECOVERY_REBOOT_MIN_UPTIME_SEC
	int "Seconds after boot during which no automatic recovery reboot may fire"
	depends on TOTEM_RECOVERY_REBOOT
	default 60
	range 10 600
	help
	  Loop breaker: recovery state does not survive a reboot, so without an
	  uptime floor a permanently broken controller could reboot, be asked to
	  recover again, and reboot forever. Below this uptime the reboot is
	  suppressed and only logged.
```
